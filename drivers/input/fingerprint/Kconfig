## drivers/input/fingerprint/Kconfig
```kconfig
#
#Fingerprint
#

source "$(KCONFIG_EXT_PREFIX)drivers/input/fingerprint/goodix/Kconfig"
```

## drivers/input/fingerprint/goodix/Kconfig
```kconfig
#
# Goodix fingerprint driver configuration
#
config GOODIX_FINGERPRINT
	tristate "Goodix fingerprint driver"
	help 
	   Say Y here if you have a Goodix fingerprint connected
	   to your system by SPI bus.
	   If unsure, say N.
	   
```

## drivers/input/hall/Kconfig
```kconfig
config INPUT_HALL
	tristate "hall for MediaTek alsps package"
        default y
	 help
         Say Y to enable support for hall.
```

## drivers/input/sar/Kconfig
```kconfig
# SPDX-License-Identifier: GPL-2.0-only
#
# Input core configuration
#

config HX9023S_SAR
	tristate "Support for hx9023s sar sensor"
	default y
	help
	  Say Y to enable support for TYHX_HX9023S.
config HX9036_SAR
	tristate "Support for hx9036 sar sensor"
	default y
	help
	  Say Y to enable support for TYHX_HX9036.
config SENSORS
        tristate "Sensors Class Support"
	default y
        help
          This option enables the sensor sysfs class in /sys/class/sensors.
          You'll need this to do anything useful with sensors. If unsure,say N.
```

## drivers/misc/mediatek/afw/Kconfig
```kconfig
config MICROTRUST_AFW_SUPPORT
	tristate "MICROTRUST afw driver"
	help
	  This is afw driver, it is used to get secure handle from dma-buf
```

## drivers/misc/mediatek/gate_ic/Kconfig
```kconfig
config MTK_GATE_IC
	tristate "MediaTek Gate IC Support"
	help
	  This selects the MediaTek(R) Gate IC connected to MediaTek chips.
	  If you want to use MediaTek(R) Gate IC  support, say Y or M here.
	  If unsure, say N.
	  Mediatek GATE IC module includes display gate ic, backlight gate ic.

config RT4831A_I2C
	tristate "Support rt4831 gate ic board"
	help
	  I2C gate driver for RT4831 support.
	  Set y to support.
	  Set n to disable.
	  RT4831 I2C driver for display and backlight.

config SM5109_I2C
	tristate "Support sm5109 bias ic board"
	help
	  I2C gate driver for sm5109 support.
	  Set y to support.
	  Set n to disable.
	  SM5109 I2C driver for display.

config SGM37604A_I2C
	tristate "Support sgm37604a backlight ic board"
	help
	  I2C gate driver for sgm37604a support.
	  Set y to support.
	  Set n to disable.
	  SGM37604A I2C driver for display.

config SECOND_SGM37604A_I2C
	tristate "Support sgm37604a backlight ic board"
	help
	  I2C gate driver for sgm37604a support.
	  Set y to support.
	  Set n to disable.
	  SGM37604A I2C driver for display.
```

## drivers/misc/mediatek/korea_afw/Kconfig
```kconfig
config MICROTRUST_KOREA_AFW_SUPPORT
	tristate "MICROTRUST korea afw driver"
	help
	  This is korea afw driver, it is used to get secure handle
```

## kernel/sched/lenovohypersched/Kconfig
```kconfig
menu "Lenovo hyper schedule"

config LENOVO_HYPER_SCHED
        tristate "Lenovo hyper schedule support"
        default n
        help
            If you want Lenovo hyper sched support,you should say Y or M here.

endmenu
```
